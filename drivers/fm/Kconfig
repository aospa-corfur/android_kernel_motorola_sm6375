## drivers/fm/Kconfig
```kconfig
config FM_ELNA
        tristate "FM_ELNA"
        default n
        help
         Say Y here if you have a FM_ELNA compatible
         device defined.

         This driver can also be built as a module.  If so, the module
         will be called fm_ctrl.
```
